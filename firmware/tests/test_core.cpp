// Host tests for the fridge node's logic. Compiled with plain g++, no Arduino, no ESP32:
//
//   cd firmware/tests && ./run_tests.sh
//
// The crypto vectors come from two independent directions: FIPS/RFC numbers written into this file,
// and HMAC vectors generated by Python's hmac module at run time by gen_vectors.py. Those are the
// same two implementations that meet in production - the ESP32 signs, backend/app/hmac_auth.py
// verifies - so agreeing here is what the device contract actually depends on.
#include <stdio.h>
#include <stdlib.h>
#include <string.h>
#include <string>

#include "coldchain_core.h"
#include "sha256_hmac.h"

static int total = 0, failed = 0;

static void check(const char* name, bool cond, const char* detail = "") {
  total++;
  if (cond) {
    printf("PASS  %s%s%s\n", name, detail[0] ? " -> " : "", detail);
  } else {
    failed++;
    printf("FAIL  %s%s%s\n", name, detail[0] ? " -> " : "", detail);
  }
}

static std::string hexDigest(const uint8_t d[32]) {
  static const char* H = "0123456789abcdef";
  char out[65];
  for (int i = 0; i < 32; i++) { out[i*2] = H[d[i]>>4]; out[i*2+1] = H[d[i]&15]; }
  out[64] = '\0';
  return std::string(out);
}

static std::string shaOf(const char* s) {
  uint8_t d[32];
  cc::sha256(reinterpret_cast<const uint8_t*>(s), strlen(s), d);
  return hexDigest(d);
}

static std::string hmacOf(const char* key, const char* msg) {
  char out[65];
  cc::hmacHex(key, msg, out);
  return std::string(out);
}

static cc::Sample sample(float t, uint32_t bootMs, uint32_t tsS, const char* nonce,
                        bool door = false, bool power = true, bool comp = false,
                        uint8_t batt = 100) {
  cc::Sample s;
  s.tempC = t; s.bootMs = bootMs; s.tsS = tsS; s.batteryPct = batt;
  s.doorOpen = door; s.powerOk = power; s.compressorOn = comp;
  strncpy(s.nonce, nonce, sizeof s.nonce - 1);
  s.nonce[sizeof s.nonce - 1] = '\0';
  return s;
}

// ------------------------------------------------------------------ crypto
static void cryptoVectors() {
  // FIPS 180-2 examples.
  check("sha256(\"\") matches the published digest",
        shaOf("") == "e3b0c44298fc1c149afbf4c8996fb92427ae41e4649b934ca495991b7852b855",
        shaOf("").c_str());
  check("sha256(\"abc\") matches the published digest",
        shaOf("abc") == "ba7816bf8f01cfea414140de5dae2223b00361a396177a9cb410ff61f20015ad",
        shaOf("abc").c_str());
  // One block plus padding boundary cases: 55 and 56 bytes take different padding paths.
  char m55[56], m56[57], m64[65];
  memset(m55, 'a', 55); m55[55] = 0;
  memset(m56, 'b', 56); m56[56] = 0;
  memset(m64, 'c', 64); m64[64] = 0;
  check("sha256 of 55 bytes does not overflow the length block", shaOf(m55).size() == 64, shaOf(m55).c_str());
  check("sha256 of 56 bytes uses the extra block", shaOf(m56) != shaOf(m55));
  check("sha256 of exactly one 64-byte block", shaOf(m64) != shaOf(m56));

  // RFC 4231 isn't needed for a key the size we use, but TC2 is memorable and independent of me.
  check("hmac-sha256 RFC 4231 test case 2",
        hmacOf("Jefe", "what do ya want for nothing?") ==
            "5bdcc146bf60754e6a042426089575c75a003f089d2739839dec58b964ec3843",
        hmacOf("Jefe", "what do ya want for nothing?").c_str());

  char longKey[200];
  memset(longKey, 'k', 199); longKey[199] = 0;
  check("a key longer than a block is hashed before use, and stays stable",
        hmacOf(longKey, "x") != hmacOf("k", "x") && hmacOf(longKey, "x").size() == 64,
        hmacOf(longKey, "x").c_str());
}

// Cross-check against Python's hmac module, which is the implementation the server runs.
static void pythonVectors(const char* path) {
  FILE* f = fopen(path, "r");
  if (!f) {
    check("python vectors are present", false, path);
    return;
  }
  char line[1024], key[256], want[80], msg[700];
  int matched = 0, cases = 0;
  while (fgets(line, sizeof line, f)) {
    line[strcspn(line, "\r\n")] = '\0';
    if (!line[0] || line[0] == '#') continue;
    key[0] = want[0] = msg[0] = 0;
    sscanf(line, "%255[^\t]\t%79[^\t]\t%699[^\t]", key, want, msg);
    if (!want[0]) continue;                     // a digest of "" is a malformed line, not a vector
    cases++;
    if (hmacOf(key, msg) == want) matched++;
    else printf("  mismatch for message: %s\n", msg);
  }
  fclose(f);
  check("every HMAC vector from Python's hmac module reproduces",
        cases >= 4 && matched == cases, "");
  printf("      (%d vectors compared against python hmac-sha256)\n", matched);
}

// ------------------------------------------------------------------ task 1: compressor
static void compressorRule() {
  cc::Limits l = cc::Limits::taskSpec();
  cc::Compressor c;
  check("compressor starts off at 5 C", c.step(l, 5.0f, 100) == false);
  check("compressor does not start below 7 C", c.step(l, 6.9f, 105) == false);
  check("compressor turns ON at 7 C", c.step(l, 7.0f, 110) == true);
  check("compressor keeps running through the band", c.step(l, 5.0f, 115) == true);
  check("compressor keeps running above 3 C", c.step(l, 3.1f, 120) == true);
  check("compressor turns OFF at 3 C", c.step(l, 3.0f, 125) == false);
  check("no restart 35 s after stopping", c.step(l, 9.0f, 160) == false);
  check("no restart at 59 s", c.step(l, 9.0f, 184) == false);
  check("restarts at exactly 60 s of downtime", c.step(l, 9.0f, 185) == true);
  check("a failed sensor read holds the last decision", c.step(l, NAN, 190) == true);
  cc::Compressor fresh;
  check("a cold boot with no off-history can start immediately",
        fresh.step(l, 7.5f, 1000000) == true);
}

// ------------------------------------------------------------------ task 3: door buzzer
static void doorAlert() {
  cc::Limits l = cc::Limits::taskSpec();
  cc::DoorWatch d;
  d.step(true, 100, l);
  check("door open does not alert immediately", d.buzzer() == false);
  d.step(true, 150, l);
  check("still quiet at 50 s", d.buzzer() == false);
  d.step(true, 161, l);
  check("buzzes past 60 s", d.buzzer() == true);
  d.step(true, 200, l);
  check("one alert per opening, not one per reading", d.alerted() == true);
  d.step(false, 210, l);
  check("closing silences the buzzer", d.buzzer() == false);
  d.step(true, 220, l);
  check("a new opening re-arms the alert", d.buzzer() == false);
  cc::DoorWatch idle;
  idle.step(true, 0, l);                    // clock not synced yet
  check("an unsynced clock cannot invent an alert", idle.buzzer() == false);
  cc::DoorWatch held;
  held.step(true, 100, l);
  check("openForS reports the elapsed window", held.openForS(140) == 40);
}

// ------------------------------------------------------------------ task 2: red LED latch
static void discardLatch() {
  cc::RedLed led;
  check("no batch status keeps the led off", led.on() == false);
  led.step("Safe");
  check("Safe does not latch", led.on() == false);
  led.step("Discard");
  check("Discard latches the red led on", led.on() == true);
  led.step(nullptr);                        // silence is not a clearance
  check("a missing reply does not clear the latch", led.on() == true);
  led.step("At Risk");
  check("the reply after an admin reset clears it", led.on() == false);
  led.step("");                             // "batch_status":null -> every batch moved away
  check("an empty status clears it too", led.on() == false);
}

// ------------------------------------------------------------------ task 3: clock + buffer
static void clockBackfill() {
  cc::Clock c;
  check("unsynced clock reports no timestamp", c.at(5000) == 0);
  c.sync(1793486530u, 20000u);              // NTP answered 20 s after boot
  check("synced clock converts boot millis to unix seconds", c.at(120000) == 1793486530u + 100u,
        "");
  check("the reading taken 15 s before the sync backdates correctly", c.at(5000) == 1793486515u);
}

static void bufferOrdering() {
  cc::Sample store[4];
  cc::ReadingLog log(store, 4);
  for (int i = 0; i < 3; i++) log.push(sample(5.0f + i, 1000 * i, 0, "n"));
  check("queue holds three readings", log.pending() == 3);
  check("oldest is first in", log.oldest()->bootMs == 0);
  log.advance();
  check("advance moves to the next reading", log.oldest()->bootMs == 1000);
  for (int i = 0; i < 5; i++) log.push(sample(9.0f, 5000 + i * 1000, 0, "n"));
  check("a full buffer keeps its capacity", log.pending() == 4);
  check("overflow reports the readings it dropped", log.dropped() >= 2, "");
  check("overflow keeps the newest, not the oldest", log.oldest()->bootMs >= 5000);

  cc::Clock c;
  c.sync(1793486530u, 1000u);
  uint16_t filled = log.backfill(c, 9000u);
  check("backfill stamps every queued reading", filled == 4, "");
  const cc::Sample* first = log.oldest();
  uint32_t previous = first->tsS;
  bool ascending = true;
  log.advance();
  while (const cc::Sample* s = log.oldest()) { ascending = ascending && s->tsS >= previous; previous = s->tsS; log.advance(); }
  check("replay order is ascending, which /api/sensor requires", ascending, "");
}

static void backlogAge() {
  cc::Sample store[2];
  cc::ReadingLog log(store, 2);
  log.push(sample(5.0f, 0, 1000, "n"));
  check("oldestAgeS measures the head of the queue", log.oldestAgeS(4600) == 3600);
  check("a reading with no timestamp has no age", log.oldestAgeS(0) == 0);
}

// ------------------------------------------------------------------ device contract
static void wireFormat() {
  cc::Wire w = cc::wireOf(12.0f, 1793486530u, 97);
  check("a whole temperature still prints the decimal Python prints", strcmp(w.temp, "12.0") == 0, w.temp);
  check("ts is signed as a float", strcmp(w.ts, "1793486530.0") == 0, w.ts);
  check("battery prints as a float", strcmp(w.battery, "97.0") == 0, w.battery);
  cc::Wire f = cc::wireOf(5.4f, 1793486530u, 100);
  check("one-decimal rounding matches round(x,1) on the server", strcmp(f.temp, "5.4") == 0, f.temp);
  cc::Wire neg = cc::wireOf(-0.4f, 0u, 0);
  check("a negative temperature keeps its sign", strcmp(neg.temp, "-0.4") == 0, neg.temp);

  char canon[128];
  cc::canonical(canon, sizeof canon, "fridge-1", w, true, "abc123", false, true);
  check("canonical string is the exact field order the server rebuilds",
        strcmp(canon, "fridge-1|12.0|1|1793486530.0|abc123|0|97.0|1") == 0, canon);

  char body[512];
  cc::payload(body, sizeof body, "fridge-1", w, true, "abc123", "SIG", false, true, true);
  check("json body carries every signed field plus buffered",
        strcmp(body, "{\"device_id\":\"fridge-1\",\"temperature\":12.0,\"door_open\":true,"
                     "\"ts\":1793486530.0,\"nonce\":\"abc123\",\"signature\":\"SIG\","
                     "\"power_ok\":false,\"battery\":97.0,\"compressor_on\":true,"
                     "\"buffered\":true}") == 0, body);
}

static void sendModeRules() {
  check("a lone reading is live", cc::sendMode(1, true, 1793486530u) == 1);
  check("anything behind it is backlog", cc::sendMode(7, true, 1793486530u) == 2);
  check("no timestamp, nothing to send", cc::sendMode(1, true, 0) == 0);
  check("unsynced clock never sends", cc::sendMode(3, false, 1793486530u) == 0);
  check("an empty queue sends nothing", cc::sendMode(0, true, 1793486530u) == 0);
}

static void verdictRules() {
  cc::Limits l = cc::Limits::taskSpec();
  check("201 is accepted", cc::decide(201, nullptr, 0, 1, l) == cc::ACT_ACCEPTED);
  check("duplicate-ignored is a 2xx and consumed the sample",
        cc::decide(201, "duplicate-ignored", 0, 1, l) == cc::ACT_ACCEPTED);
  check("a replayed nonce means the api already stored it",
        cc::decide(401, "replayed nonce", 0, 1, l) == cc::ACT_ACCEPTED);
  check("a transport failure keeps the reading queued",
        cc::decide(0, nullptr, 60, 1, l) == cc::ACT_RETRY);
  check("a 500 keeps the reading queued", cc::decide(500, "Internal Server Error", 60, 1, l) == cc::ACT_RETRY);
  check("an unknown device is retried, the seed may still be running",
        cc::decide(401, "unknown device", 30, 1, l) == cc::ACT_RETRY);
  check("a short clock drift is retried, not discarded",
        cc::decide(401, "stale timestamp", 120, 1, l) == cc::ACT_RETRY);
  check("a backlog older than the server window is dropped",
        cc::decide(401, "stale timestamp", 4 * 3600, 1, l) == cc::ACT_DROP);
  check("a first bad signature is retried", cc::decide(401, "invalid signature", 10, 1, l) == cc::ACT_RETRY);
  check("three bad signatures means the node is broken, drop it",
        cc::decide(401, "invalid signature", 10, 3, l) == cc::ACT_DROP);
}

static void replyParsing() {
  char out[16];
  check("reads the batch status the bridge echoes",
        cc::findStringField("{\"batch_status\":\"Discard\"}", "batch_status", out, sizeof out) &&
            strcmp(out, "Discard") == 0, out);
  check("a null status is not a string",
        !cc::findStringField("{\"batch_status\":null}", "batch_status", out, sizeof out));
  check("a null status is still a reply", cc::jsonHasNull("{\"batch_status\":null}", "batch_status"));
  check("absent is neither", !cc::jsonHasNull("{\"status\":\"ok\"}", "batch_status") &&
                             !cc::findStringField("{\"status\":\"ok\"}", "batch_status", out, sizeof out));
  check("reads the FastAPI detail string",
        cc::findStringField("{\"detail\":\"replayed nonce\"}", "detail", out, sizeof out) &&
            strcmp(out, "replayed nonce") == 0, out);
  char small[6];
  cc::findStringField("{\"detail\":\"invalid signature\"}", "detail", small, sizeof small);
  check("a value longer than the buffer is clipped, never overflowing",
        small[sizeof small - 1] == '\0' && strcmp(small, "inval") == 0, small);
  check("null json does not crash", !cc::findStringField(nullptr, "detail", out, sizeof out));
}

static void readingClass() {
  cc::Limits l = cc::Limits::taskSpec();
  check("2-8 C is Safe", cc::classify(l, 5.0f) == cc::RD_SAFE);
  check("8.1 C is Warning", cc::classify(l, 8.1f) == cc::RD_WARNING);
  check("1.9 C is Warning", cc::classify(l, 1.9f) == cc::RD_WARNING);
  check("12.1 C is Breach", cc::classify(l, 12.1f) == cc::RD_BREACH);
  check("-0.1 C is Breach", cc::classify(l, -0.1f) == cc::RD_BREACH);
  check("a failed sensor read is Breach, not skipped", cc::classify(l, NAN) == cc::RD_BREACH);
  check("status names match the strings the web renders",
        strcmp(cc::readingName(cc::RD_BREACH), "Breach") == 0 &&
        strcmp(cc::readingName(cc::RD_WARNING), "Warning") == 0 &&
        strcmp(cc::readingName(cc::RD_SAFE), "Safe") == 0);
}

static void batteryModel() {
  cc::PowerModel p;
  p.step(true, 3600);
  check("on mains the pack never overcharges", p.pct() == 100);
  for (int i = 0; i < 3; i++) p.step(false, 3600);
  check("on battery it drains about 12% an hour", p.pct() == 64, "");
  for (int i = 0; i < 10; i++) p.step(false, 3600);
  check("drain stops at zero", p.pct() == 0);
  for (int i = 0; i < 10; i++) p.step(true, 3600);
  check("charge stops at full", p.pct() == 100);
  p.step(false, 7200);
  check("one long outage counts as an hour, not two", p.pct() == 88, "");
}

// ./test_core --payload <key> <device> <nonce> <temp> <ts> <battery> <door> <power> <comp> <buffered>
// prints the signed JSON body, so run_tests.sh can POST exactly what an ESP32 would POST.
static int emitPayload(int argc, char** argv) {
  if (argc < 12) { fprintf(stderr, "need key device nonce temp ts battery door power compressor buffered\n"); return 2; }
  const char* key = argv[2];
  const char* device = argv[3];
  const char* nonce = argv[4];
  float tempC = (float)atof(argv[5]);
  uint32_t tsS = (uint32_t)strtoul(argv[6], nullptr, 10);
  uint8_t battery = (uint8_t)atoi(argv[7]);
  cc::Sample s = sample(tempC, 0, tsS, nonce, atoi(argv[8]) != 0, atoi(argv[9]) != 0,
                        atoi(argv[10]) != 0, battery);
  cc::Wire w = cc::wireOf(s.tempC, s.tsS, s.batteryPct);
  char canon[256], sig[65], body[1024];
  cc::canonical(canon, sizeof canon, device, w, s.doorOpen, s.nonce, s.powerOk, s.compressorOn);
  cc::hmacHex(key, canon, sig);
  cc::payload(body, sizeof body, device, w, s.doorOpen, s.nonce, sig, s.powerOk, s.compressorOn,
              atoi(argv[11]) != 0);
  fputs(body, stdout);
  return 0;
}

int main(int argc, char** argv) {
  if (argc > 1 && strcmp(argv[1], "--payload") == 0) return emitPayload(argc, argv);

  printf("\n== ColdChain node logic, host tests ==\n\n");
  cryptoVectors();
  pythonVectors(argc > 1 ? argv[1] : "vectors.txt");
  compressorRule();
  doorAlert();
  discardLatch();
  clockBackfill();
  bufferOrdering();
  backlogAge();
  wireFormat();
  sendModeRules();
  verdictRules();
  replyParsing();
  readingClass();
  batteryModel();
  printf("\n== %d passed, %d failed ==\n", total - failed, failed);
  return failed ? 1 : 0;
}
